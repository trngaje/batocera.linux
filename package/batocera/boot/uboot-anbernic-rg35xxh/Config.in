## package/batocera/boot/uboot-anbernic-rg35xxh/Config.in
```kconfig
config BR2_PACKAGE_UBOOT_ANBERNIC_RG35XXH
	bool "U-Boot for Anbernic RG35XXH family"
	help
	  u-boot for Anbernic RG35XXH
```

## package/batocera/emulators/advancemame-bin/Config.in
```kconfig
config BR2_PACKAGE_ADVANCEMAME_BIN
    bool "advancemame-bin"
    help
      A MAME and MESS port with an advanced video support for Arcade Monitors, TVs, and PC Monitor
	  
	  https://github.com/trngaje/advancemame
```

## package/batocera/emulators/drastic_steward/Config.in
```kconfig
config BR2_PACKAGE_DRASTIC_STEWARD
	bool "drastic_steward"
	help
          Drastic Steward
          Is a NDS emulateur for linux.

           https://github.com/steward-fu/nds
```

## package/batocera/emulators/retroarch/libretro/libretro-snes9x2005/Config.in
```kconfig
config BR2_PACKAGE_LIBRETRO_SNES9X2005
    bool "libretro-snes9x2005"
	depends on BR2_PACKAGE_RETROARCH
	depends on BR2_INSTALL_LIBSTDCPP
      help
        Snes9x2005 - Portable Super Nintendo Entertainment System (TM) emulator http://www.snes9x.com

	  http://www.libretro.com

comment "LIBRETRO_SNES9X2005 needs a toolchain w/ C++"
	depends on !BR2_INSTALL_LIBSTDCPP
```

## package/batocera/emulators/retroarch/libretro/libretro-vb/Config.in
```kconfig
menuconfig BR2_PACKAGE_LIBRETRO_VB
	bool "libretro-vb"
	depends on BR2_PACKAGE_RETROARCH
	help
	  libretro implementation of vb
```

## package/batocera/utils/gmu/Config.in
```kconfig
config BR2_PACKAGE_GMU
	bool "gmu"
	select BR2_PACKAGE_SPEEX
	help
	  Gmu is a music player application.
	  https://github.com/trngaje/gmu
```

## package/batocera/utils/sdl-flip-clock/Config.in
```kconfig
config BR2_PACKAGE_SDL_FLIP_CLOCK
    bool "sdl-flip-clock"
    help
      This is a simple Flip Clock created using SDL.
	  
	  https://github.com/JaeSeoKim/sdl-flip-clock
```
